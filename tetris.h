#include "garfield.h"
#include "math.h"

#ifndef TETRIS
#define TETRIS

namespace tetris
{

const uint16_t logo[] = {0, 0, 0, 0, 0, 0, 0, 0, 0,
                         0, 0, 0, 0, 0, 0, 0, 0, 0, 0,
                         0, 0, 0, 0, 0, 0, 0, 0, 0, 0,
                         0, 0, 0, 0, 0, 0, 0, 0, 0, 0,
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                         0, 0, 0, 0, 0, 0, 0, 0, 0};
int logo_width = 78;
int logo_height = 96;

const uint8_t blocks[] = {
    1, 1, 0, 0,
    1, 1, 0, 0,
    0, 0, 0, 0,
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    0, 0, 0, 0,

    /************************/
    0, 1, 0, 0,
    0, 1, 0, 0,
    0, 1, 0, 0,
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    0, 0, 0, 0,
    /************************/
    0, 1, 0, 0,
    1, 1, 1, 0,
    0, 0, 0, 0,
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    0, 0, 0, 0,

    /*******************/
    0, 1, 0, 0,
    1, 1, 0, 0,
    1, 0, 0, 0,
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    0, 0, 0, 0,
    /****************************/
    1, 0, 0, 0,
    1, 1, 0, 0,
    0, 1, 0, 0,
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    0, 0, 0, 0,
    /****************************/
    1, 1, 0, 0,
    0, 1, 0, 0,
    0, 1, 0, 0,
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    0, 0, 0, 0,
    /****************************/
    1, 1, 0, 0,
    1, 0, 0, 0,
    1, 0, 0, 0,
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    0, 0, 0, 0};

#define SCREEN_WIDTH 320
#define SCREEN_HEIGHT 240

#define GAME_STATE_RUN 0

bool gameRunning;

const uint16_t colorCode[] = {TFT_BLACK, TFT_RED, TFT_CYAN, TFT_BLUE, TFT_GREEN, TFT_YELLOW};
const uint8_t WALL = 255;
const int pieSize = 10;
const int boxCols = 15;
const int boxRows = 23;
uint8_t *box;
int score = 0;

const uint16_t blockStroke = 0xAD55;

int nextBlockType = 0;
int nextBlockState = 0;
uint16_t nextBlockColorCode = 0;

int crBlockI, crBlockJ;
int crBlockType;
int crBlockState;
uint16_t crBlockColorCode;

// event will be trigger when  (value > 0) turn to (value <= 0)
const float gravityWaitTime = 0.3;

float gravityRemainTickTime = 1;

//long press
uint8_t keyMask = 255;
float keyboardWaitTime = 0.15;
float goLeftRemainTime = -1;    //disable
float goRightRemainTime = -1;   //disable
float cwRotateRemainTime = -1;  //disable
float icwRotateRemainTime = -1; //disable
float goDownRemainTime = -1;

void drawBlock(int type, int state, int x, int y, uint16_t stroke, uint16_t fill)
{
    for (int i = 0; i < 4; ++i)
        for (int j = 0; j < 4; ++j)
        {
            if (blocks[(type << 6) | (state << 4) | (i << 2) | j])
            {
                M5.Lcd.fillRect(x + j * pieSize + 1, y + i * pieSize + 1, pieSize - 2, pieSize - 2, fill);
                M5.Lcd.drawRect(x + j * pieSize, y + i * pieSize, pieSize, pieSize, stroke);
            }
        }
}

uint8_t getBlockAt(int type, int state, int i, int j)
{
    return blocks[(type << 6) | (state << 4) | (i << 2) | j];
}

uint8_t getBoxAt(uint8_t *box, int i, int j)
{
    if (i >= boxRows || j < 0 || j >= boxCols)
        return WALL;
    if (i < 0)
        return 0;
    return box[i * boxCols + j];
}

uint8_t getBoxAt(int i, int j)
{
    return getBoxAt(box, i, j);
}

void setBoxAt(uint8_t *box, int i, int j, uint8_t value)
{
    if (i < 0 || i >= boxRows || j < 0 || j >= boxCols)
        return;
    box[i * boxCols + j] = value;
}

void setBoxAt(int i, int j, uint8_t value)
{
    setBoxAt(box, i, j, value);
}

bool blockIsHit(uint8_t *box, int type, int state, int iPos, int jPos)
{
    for (int i = 0; i < 4; ++i)
        for (int j = 0; j < 4; ++j)
        {
            if (!getBlockAt(type, state, i, j))
                continue;
            if (iPos + i < 0)
                continue;

            if (iPos + i >= boxRows)
                return true;
            if (getBoxAt(box, iPos + i, jPos + j))
                return true;
        }
    return false;
}

bool blockIsHit(int type, int state, int iPos, int jPos)
{
    return blockIsHit(box, type, state, iPos, jPos);
}

int blockIsOut(int type, int state, int iPos, int jPos)
{
    for (int i = 0; i < 4; ++i)
        for (int j = 0; j < 4; ++j)
        {
            if (!getBlockAt(type, state, i, j))
                continue;
            if (jPos + j < 0)
                return -1;
            if (jPos + j >= boxCols)
                return 1;
        }
    return 0;
}

void drawBlock(int type, int state, int x, int y, uint16_t fill)
{
    for (int i = 0; i < 4; ++i)
        for (int j = 0; j < 4; ++j)
        {
            if (blocks[(type << 6) | (state << 4) | (i << 2) | j])
            {
                M5.Lcd.fillRect(x + j * pieSize, y + i * pieSize, pieSize, pieSize, fill);
            }
        }
}

void drawScore()
{
    M5.Lcd.setTextColor(0xF800, TFT_BLACK);
    M5.Lcd.setTextSize(3);
    M5.Lcd.setCursor(boxCols * pieSize + 2 + 23, 28);
    M5.Lcd.printf("%07d", score);
}
void drawFrame()
{
    M5.Lcd.drawBitmap(SCREEN_WIDTH - 5 - logo_width, SCREEN_HEIGHT - 5 - logo_height, logo_width, logo_height, logo, TFT_BLACK);
    M5.Lcd.drawRect(1, 4 - pieSize, boxCols * pieSize + 2, boxRows * pieSize + pieSize + 2, TFT_WHITE);
    M5.Lcd.setTextSize(2);
    M5.Lcd.setCursor(boxCols * pieSize + 2 + 10, 10);
    M5.Lcd.setTextColor(0xFB40);
    M5.Lcd.print("Score");

    M5.Lcd.drawRect(SCREEN_WIDTH - 20 - pieSize * 4 - 10, 60, pieSize * 4 + 20, pieSize * 4 + 20, 0x8D33);
}

void drawNextBlock()
{
    drawBlock(nextBlockType, nextBlockState, SCREEN_WIDTH - 20 - pieSize * 4, 70, blockStroke, colorCode[nextBlockColorCode]);
}

void drawBlackNextBlock()
{
    drawBlock(nextBlockType, nextBlockState, SCREEN_WIDTH - 20 - pieSize * 4, 70, colorCode[0]);
}

void drawBox()
{
    M5.Lcd.fillRect(2, 5, pieSize * boxCols, pieSize * boxRows, TFT_BLACK);
    int x, y;
    for (int i = 0; i < 345; ++i)
    {
        if (!box[i])
            continue;
        x = 2 + (i % boxCols) * pieSize;
        y = 5 + (i / boxCols) * pieSize;
        M5.Lcd.drawRect(x, y, pieSize, pieSize, blockStroke);
        M5.Lcd.fillRect(x + 1, y + 1, pieSize - 2, pieSize - 2, colorCode[box[i]]);
    }
}

void drawCrBlock()
{
    int x, y;
    x = 2 + pieSize * crBlockJ;
    y = 5 + pieSize * crBlockI;
    drawBlock(crBlockType, crBlockState, x, y, blockStroke, colorCode[crBlockColorCode]);
}

void drawBlackCrBlock()
{
    int x, y;
    x = 2 + pieSize * crBlockJ;
    y = 5 + pieSize * crBlockI;
    drawBlock(crBlockType, crBlockState, x, y, colorCode[0]);
}

void bindCrBlock()
{
    for (int i = 0; i < 4; ++i)
        for (int j = 0; j < 4; ++j)
        {
            if (!blocks[(crBlockType << 6) | (crBlockState << 4) | (i << 2) | j])
                continue;
            if (crBlockI + i < boxRows && crBlockI + i >= 0 && crBlockJ + j < boxCols && crBlockJ + j >= 0)
                box[(crBlockI + i) * 15 + crBlockJ + j] = crBlockColorCode;
        }
}

void dropNewBlock()
{
    drawBlackNextBlock();
    crBlockColorCode = nextBlockColorCode;
    crBlockState = nextBlockState;
    crBlockType = nextBlockType;
    crBlockJ = 6;
    crBlockI = -4;

    nextBlockType = random(7);
    nextBlockState = random(4);
    nextBlockColorCode = 1 + random(5);
    drawNextBlock();
}

void clearBox()
{
    for (int i = 0; i < 345; ++i)
    {
        box[i] = 0;
    }
}

bool canGoDown()
{
    return !blockIsHit(crBlockType, crBlockState, crBlockI + 1, crBlockJ);
}

bool canGoLeft()
{
    return !blockIsHit(crBlockType, crBlockState, crBlockI, crBlockJ - 1);
}

bool canGoRight()
{
    return !blockIsHit(crBlockType, crBlockState, crBlockI, crBlockJ + 1);
}

void goDown()
{
    drawBlackCrBlock();
    crBlockI++;
    drawCrBlock();
}

void goLeft()
{
    drawBlackCrBlock();
    crBlockJ--;
    drawCrBlock();
    printf("go left\n");
}

void goRight()
{
    drawBlackCrBlock();
    crBlockJ++;
    drawCrBlock();
    printf("go right\n");
}

bool cwRotate()
{
    int nState = (crBlockState + 1) % 4;
    int nJ = crBlockJ;
    while (blockIsOut(crBlockType, nState, crBlockI, nJ) < 0)
    {
        nJ++;
    }
    while (blockIsOut(crBlockType, nState, crBlockI, nJ) > 0)
    {
        nJ--;
    }

    if (!blockIsHit(crBlockType, nState, crBlockI, nJ))
    {
        drawBlackCrBlock();
        crBlockJ = nJ;
        crBlockState = nState;
        drawCrBlock();
        return true;
    }
    return false;
}

bool icwRotate()
{
    int nState = (crBlockState + 3) % 4;
    int nJ = crBlockJ;
    while (blockIsOut(crBlockType, nState, crBlockI, nJ) < 0)
    {
        nJ++;
    }
    while (blockIsOut(crBlockType, nState, crBlockI, nJ) > 0)
    {
        nJ--;
    }

    if (!blockIsHit(crBlockType, nState, crBlockI, nJ))
    {
        drawBlackCrBlock();
        crBlockJ = nJ;
        crBlockState = nState;
        drawCrBlock();
        return true;
    }
    return false;
}

void gravityTick()
{
    if (canGoDown())
    {
        goDown();
    }
    else
    {
        bindCrBlock();
        dropNewBlock();
        drawCrBlock();
        drawBox();
    }
}

bool updatePhysic(float dt)
{
    if (goLeftRemainTime > 0)
    {
        goLeftRemainTime -= dt;
        if (goLeftRemainTime <= 0)
        {
            if (canGoLeft())
                goLeft();
            goLeftRemainTime = keyboardWaitTime;
        }
    }

    if (goRightRemainTime > 0)
    {
        goRightRemainTime -= dt;
        if (goRightRemainTime <= 0)
        {
            if (canGoRight())
                goRight();
            goRightRemainTime = keyboardWaitTime;
        }
    }

    if (cwRotateRemainTime > 0)
    {
        cwRotateRemainTime -= dt;
        if (cwRotateRemainTime <= 0)
        {
            cwRotate();
            cwRotateRemainTime = keyboardWaitTime * 1.5;
        }
    }

    if (icwRotateRemainTime > 0)
    {
        icwRotateRemainTime -= dt;
        if (icwRotateRemainTime <= 0)
        {
            icwRotate();
            icwRotateRemainTime = keyboardWaitTime * 1.5;
        }
    }

    bool needtriggerGravity = false;
    if (gravityRemainTickTime > 0)
    {
        gravityRemainTickTime -= dt;
        if (gravityRemainTickTime <= 0)
        {
            needtriggerGravity = true;
        }
    }

    if (goDownRemainTime > 0)
    {
        goDownRemainTime -= dt;
        if (goDownRemainTime <= 0)
        {
            needtriggerGravity = true;
            goDownRemainTime = keyboardWaitTime / 3;
        }
    }
    if (needtriggerGravity)
    {
        gravityTick();
        gravityRemainTickTime = gravityWaitTime;
    }
    return true;
}

bool updateScore(float dt)
{
    int bottom = boxRows - 1;
    int fullRows = 0;
    for (int i = boxRows - 1; i >= -1; --i)
    {
        int s = 0;
        for (int j = 0; j < boxCols; ++j)
        {
            if (getBoxAt(i, j))
                ++s;
        }
        if (s < boxCols)
        {
            //
            if (bottom != i)
            {
                for (int j = 0; j < boxCols; ++j)
                {
                    setBoxAt(bottom, j, getBoxAt(i, j));
                }
            }
            bottom--;
        }
        else {
            fullRows++;
        }
    }
    if (fullRows > 0){
        score += 1<<fullRows;
        drawScore();
        drawBox();
        drawCrBlock();
        return true;
    }
    else{
        if (bottom <0){

        }
        return false;
    }

}

void update(float dt)
{
    if (gameRunning)
    {
        if (updateScore(dt))
        {
            // NOOP
        }
        else
            updatePhysic(dt);
    }
}

void handleKeyboard(uint8_t key)
{
    keyMask = ~key;
    if (!(key & G_KEY_START))
    {
        gameRunning = !gameRunning;
    }
    if (gameRunning)
    {
        if (!(key & G_KEY_LEFT))
        {
            if (canGoLeft())
                goLeft();
            goLeftRemainTime = keyboardWaitTime * 1.5; //long press
        }
        else
        {
            goLeftRemainTime = -1;
        }
        if (!(key & G_KEY_RIGHT))
        {
            if (canGoRight())
                goRight();
            goRightRemainTime = keyboardWaitTime * 1.5; //long press
        }
        else
        {
            goRightRemainTime = -1;
        }

        if (!(key & G_KEY_DOWN))
        {
            if (canGoDown())
                goDown();
            goDownRemainTime = keyboardWaitTime / 3; //faster
        }
        else
        {
            goDownRemainTime = -1;
        }

        if (!(key & G_KEY_A))
        {
            cwRotate();
            cwRotateRemainTime = keyboardWaitTime * 1.5; // slower delay
        }
        else
        {
            cwRotateRemainTime = -1;
        }
        if (!(key & G_KEY_B))
        {
            icwRotate();
            icwRotateRemainTime = keyboardWaitTime * 1.5; // slower delay
        }
        else
        {
            icwRotateRemainTime = -1;
        }
    }
}

void init()
{
    box = new uint8_t[345];
    M5.Lcd.clear();
    gDrawFunc(NULL);
    gUpdateFunc(&update);
    gKeyboardFunc(&handleKeyboard);

    drawFrame();

    drawScore();

    clearBox();
    dropNewBlock();
    dropNewBlock();

    drawNextBlock();
    drawBox();
    gameRunning = true;
}

void destroy()
{
    delete box;
    gDrawFunc(NULL);
    gUpdateFunc(NULL);
    gKeyboardFunc(NULL);
}

} // namespace tetris

#endif //TETRIS
